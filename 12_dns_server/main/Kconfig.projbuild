## 12_dns_server/main/Kconfig.projbuild
```kconfig
menu "Demo Configuration"

config WIFI_SSID
    string "WiFi SSID"
	default "tidyjiang-ssid"
	help
		SSID (network name) to connect to.

config WIFI_PASSWORD
    string "WiFi Password"
	default "tidyjiang-passwd"
	help
		WiFi password (WPA or WPA2) to use.

		Can be left blank if the network has no security set.

endmenu
```

## 17_light_utils_pwm/sdkconfig.defaults
```kconfig
# Override some defaults in mesh application project.

#
# Serial flasher config
#
CONFIG_ESPTOOLPY_FLASHSIZE_4MB=y

#
# Partition Table
#
CONFIG_PARTITION_TABLE_CUSTOM=y
```

## 25_esp32c3_flash_w25q32/components/flash_w25qxx/Kconfig.projbuild
```kconfig
menu "My_FLash_W25QXX Configuration"

    choice BRAND_FLASH
        prompt "brand 品牌选择"
        default BRAND_FLASH_OTHER
        help
            select your flash brand
    config BRAND_FLASH_OTHER
        bool "other 通用品牌"
    config ESP_CUSTOM_BOARD_WINBOND
        bool "WinBond 华邦"
    endchoice

	
	config MISO_GPIO
		int "MISO GPIO number"
		range 0 46
		default 19 if IDF_TARGET_ESP32
		default 33 if IDF_TARGET_ESP32S2
		default 18 if IDF_TARGET_ESP32C3
		help
			GPIO number (IOxx) to SPI MISO.
			Some GPIOs are used for other purposes (flash connections, etc.) and cannot be used to MISO.
			On the ESP32, GPIOs 35-39 are input-only so cannot be used as outputs.
			On the ESP32-S2, GPIO 46 is input-only so cannot be used as outputs.

	config MOSI_GPIO
		int "MOSI GPIO number"
		range 0 46
		default 23 if IDF_TARGET_ESP32
		default 35 if IDF_TARGET_ESP32S2
		default 19 if IDF_TARGET_ESP32C3
		help
			GPIO number (IOxx) to SPI MOSI.
			Some GPIOs are used for other purposes (flash connections, etc.) and cannot be used to MOSI.
			On the ESP32, GPIOs 35-39 are input-only so cannot be used as outputs.
			On the ESP32-S2, GPIO 46 is input-only so cannot be used as outputs.

	config SCLK_GPIO
		int "SCLK GPIO number"
		range 0 46
		default 18 if IDF_TARGET_ESP32
		default 36 if IDF_TARGET_ESP32S2
		default 10 if IDF_TARGET_ESP32C3
		help
			GPIO number (IOxx) to SPI SCLK.
			Some GPIOs are used for other purposes (flash connections, etc.) and cannot be used to SCLK.
			On the ESP32, GPIOs 35-39 are input-only so cannot be used as outputs.
			On the ESP32-S2, GPIO 46 is input-only so cannot be used as outputs.

	config CS_GPIO
		int "CS GPIO number"
		range 0 46
		default 5 if IDF_TARGET_ESP32
		default 34 if IDF_TARGET_ESP32S2
		default 9  if IDF_TARGET_ESP32C3
		help
			GPIO number (IOxx) to SPI CS.
			Some GPIOs are used for other purposes (flash connections, etc.) and cannot be used to CS.
			On the ESP32, GPIOs 35-39 are input-only so cannot be used as outputs.
			On the ESP32-S2, GPIO 46 is input-only so cannot be used as outputs.
    

endmenu
```

## 27_ota_https_skip_cert_option/sdkconfig.defaults
```kconfig
#
# Partition Table
#
# CONFIG_PARTITION_TABLE_SINGLE_APP is not set
# CONFIG_PARTITION_TABLE_TWO_OTA is not set
CONFIG_PARTITION_TABLE_CUSTOM=y
CONFIG_PARTITION_TABLE_CUSTOM_FILENAME="2m_ota_partitions.csv"
CONFIG_PARTITION_TABLE_FILENAME="2m_ota_partitions.csv"
CONFIG_PARTITION_TABLE_OFFSET=0x8000
CONFIG_PARTITION_TABLE_MD5=y
# end of Partition Table

#
# Example Connection Configuration
#
CONFIG_EXAMPLE_CONNECT_WIFI=y
CONFIG_EXAMPLE_WIFI_SSID="AIOT"
CONFIG_EXAMPLE_WIFI_PASSWORD="1234567890"
# CONFIG_EXAMPLE_CONNECT_ETHERNET is not set
CONFIG_EXAMPLE_CONNECT_IPV6=y
CONFIG_EXAMPLE_CONNECT_IPV6_PREF_LOCAL_LINK=y
# CONFIG_EXAMPLE_CONNECT_IPV6_PREF_GLOBAL is not set
# CONFIG_EXAMPLE_CONNECT_IPV6_PREF_SITE_LOCAL is not set
# CONFIG_EXAMPLE_CONNECT_IPV6_PREF_UNIQUE_LOCAL is not set
# end of Example Connection Configuration
```
